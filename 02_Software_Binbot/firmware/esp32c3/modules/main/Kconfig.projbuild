## 02_Software_Binbot/firmware/esp32c3/modules/main/Kconfig.projbuild
```kconfig
menu "Binbot application"

choice BINBOT_APP_PROFILE
    prompt "Application profile"
    default BINBOT_APP_ROUND_SCREEN
    help
        Select exactly one firmware profile for the shared Binbot project.

    config BINBOT_APP_ROUND_SCREEN
        bool "round_screen - small round screen"

    config BINBOT_APP_HOLOGRAPHIC_SCREEN
        bool "holographic_screen - ILI9342C display"

    config BINBOT_APP_SHOWCASE_TURNTABLE
        bool "showcase_turntable - display turntable"

    config BINBOT_APP_AMBIENT_LIGHT
        bool "ambient_light - WS2812 lighting"
endchoice

choice BINBOT_DISPLAY_DRIVER
    prompt "Display driver"
    help
        The display choice is constrained by the selected application profile.

    config BINBOT_DISPLAY_GC9A01A
        bool "GC9A01A round display (240x240)"
        depends on BINBOT_APP_ROUND_SCREEN

    config BINBOT_DISPLAY_ILI9342C
        bool "ILI9342C rectangular display (320x240)"
        depends on BINBOT_APP_HOLOGRAPHIC_SCREEN

    config BINBOT_DISPLAY_NONE
        bool "No SPI display"
        depends on BINBOT_APP_SHOWCASE_TURNTABLE || BINBOT_APP_AMBIENT_LIGHT
endchoice

menu "Ambient light"
    depends on BINBOT_APP_AMBIENT_LIGHT

    config BINBOT_LIGHT_GPIO
        int "WS2812 data GPIO"
        range 0 21
        default 19

    config BINBOT_LIGHT_LED_COUNT
        int "WS2812 LED count"
        range 1 64
        default 4
endmenu

menu "Binbot OTA"

    config BINBOT_UART_OTA_ENABLE
        bool "Enable UART firmware updates"
        default y
        select BOOTLOADER_APP_ROLLBACK_ENABLE
        help
            UART1, fixed 460800 8N1. Confirm new firmware after hardware initialization.

    config BINBOT_OTA_ENABLE
        bool "Enable Wi-Fi OTA service"
        depends on !BINBOT_UART_OTA_ENABLE && !BINBOT_APP_SHOWCASE_TURNTABLE && !BINBOT_APP_AMBIENT_LIGHT
        default n

    config BINBOT_OTA_WIFI_SSID
        string "OTA Wi-Fi SSID"
        default ""

    config BINBOT_OTA_WIFI_PASSWORD
        string "OTA Wi-Fi password"
        default ""

    config BINBOT_OTA_URL
        string "OTA firmware URL"
        default ""

    config BINBOT_OTA_MANIFEST_URL
        string "OTA version manifest URL"
        default ""
        help
            Legacy compatibility setting. The current OTA flow uses the TCP
            control channel and does not poll this manifest.

    config BINBOT_OTA_TCP_ENABLE
        bool "Enable persistent TCP OTA control channel"
        default y

    config BINBOT_OTA_TCP_HOST
        string "OTA TCP control server host"
        default ""

    config BINBOT_OTA_TCP_PORT
        int "OTA TCP control server port"
        range 1 65535
        default 8001
endmenu

endmenu
```

## 02_Software_Binbot/firmware/esp32c3/modules/sdkconfig.defaults.ambient_light
```kconfig
# CONFIG_BINBOT_APP_ROUND_SCREEN is not set
# CONFIG_BINBOT_APP_HOLOGRAPHIC_SCREEN is not set
# CONFIG_BINBOT_APP_SHOWCASE_TURNTABLE is not set
CONFIG_BINBOT_APP_AMBIENT_LIGHT=y
# CONFIG_BINBOT_DISPLAY_GC9A01A is not set
# CONFIG_BINBOT_DISPLAY_ILI9342C is not set
CONFIG_BINBOT_DISPLAY_NONE=y
CONFIG_BINBOT_LIGHT_GPIO=19
CONFIG_BINBOT_LIGHT_LED_COUNT=4
CONFIG_BINBOT_UART_OTA_ENABLE=y
CONFIG_ESPTOOLPY_FLASHSIZE_2MB=y
CONFIG_ESPTOOLPY_FLASHMODE_DIO=y
CONFIG_ESPTOOLPY_FLASHFREQ_80M=y
CONFIG_PARTITION_TABLE_CUSTOM=y
CONFIG_PARTITION_TABLE_CUSTOM_FILENAME="partitions_ota_turntable.csv"
CONFIG_BOOTLOADER_APP_ROLLBACK_ENABLE=y
CONFIG_ESP_CONSOLE_UART_DEFAULT=y
CONFIG_ESP_CONSOLE_SECONDARY_NONE=y
# GPIO19 is the WS2812 data output, so use the UART0 console.
CONFIG_ESP_CONSOLE_UART_DEFAULT=y
CONFIG_ESP_CONSOLE_SECONDARY_NONE=y
# CONFIG_ESP_CONSOLE_SECONDARY_USB_SERIAL_JTAG is not set
CONFIG_PARTITION_TABLE_CUSTOM=y
CONFIG_PARTITION_TABLE_CUSTOM_FILENAME="partitions_ota_turntable.csv"
CONFIG_ESPTOOLPY_FLASHSIZE_2MB=y
CONFIG_BOOTLOADER_APP_ROLLBACK_ENABLE=y
```

## 02_Software_Binbot/firmware/esp32c3/modules/sdkconfig.defaults.round_screen
```kconfig
CONFIG_BINBOT_APP_ROUND_SCREEN=y
# CONFIG_BINBOT_APP_HOLOGRAPHIC_SCREEN is not set
# CONFIG_BINBOT_APP_SHOWCASE_TURNTABLE is not set
CONFIG_BINBOT_DISPLAY_GC9A01A=y
# CONFIG_BINBOT_DISPLAY_ILI9342C is not set
# CONFIG_BINBOT_DISPLAY_NONE is not set
CONFIG_BINBOT_UART_OTA_ENABLE=y
# CONFIG_BINBOT_OTA_ENABLE is not set
CONFIG_ESPTOOLPY_FLASHSIZE_4MB=y
CONFIG_ESPTOOLPY_FLASHMODE_DIO=y
CONFIG_ESPTOOLPY_FLASHFREQ_80M=y
CONFIG_PARTITION_TABLE_CUSTOM=y
CONFIG_PARTITION_TABLE_CUSTOM_FILENAME="partitions_ota.csv"
CONFIG_BOOTLOADER_APP_ROLLBACK_ENABLE=y
CONFIG_FATFS_LFN_HEAP=y
CONFIG_ESP_CONSOLE_UART_DEFAULT=y
CONFIG_ESP_CONSOLE_SECONDARY_NONE=y
CONFIG_PARTITION_TABLE_CUSTOM=y
CONFIG_PARTITION_TABLE_CUSTOM_FILENAME="partitions_ota.csv"
CONFIG_ESPTOOLPY_FLASHSIZE_4MB=y
CONFIG_BOOTLOADER_APP_ROLLBACK_ENABLE=y
```

## 02_Software_Binbot/firmware/esp32c3/modules/sdkconfig.defaults.showcase_turntable
```kconfig
# CONFIG_BINBOT_APP_ROUND_SCREEN is not set
# CONFIG_BINBOT_APP_HOLOGRAPHIC_SCREEN is not set
CONFIG_BINBOT_APP_SHOWCASE_TURNTABLE=y
# CONFIG_BINBOT_DISPLAY_GC9A01A is not set
# CONFIG_BINBOT_DISPLAY_ILI9342C is not set
CONFIG_BINBOT_DISPLAY_NONE=y
CONFIG_BINBOT_UART_OTA_ENABLE=y
CONFIG_ESPTOOLPY_FLASHSIZE_2MB=y
CONFIG_ESPTOOLPY_FLASHMODE_DIO=y
CONFIG_ESPTOOLPY_FLASHFREQ_80M=y
CONFIG_PARTITION_TABLE_CUSTOM=y
CONFIG_PARTITION_TABLE_CUSTOM_FILENAME="partitions_ota_turntable.csv"
CONFIG_BOOTLOADER_APP_ROLLBACK_ENABLE=y
CONFIG_ESP_CONSOLE_UART_DEFAULT=y
CONFIG_ESP_CONSOLE_SECONDARY_NONE=y
# GPIO18/19 drive the motor, so keep console output on UART0 only.
CONFIG_ESP_CONSOLE_UART_DEFAULT=y
CONFIG_ESP_CONSOLE_SECONDARY_NONE=y
# CONFIG_ESP_CONSOLE_SECONDARY_USB_SERIAL_JTAG is not set
# CONFIG_USJ_ENABLE_USB_SERIAL_JTAG is not set
CONFIG_PARTITION_TABLE_CUSTOM=y
CONFIG_PARTITION_TABLE_CUSTOM_FILENAME="partitions_ota_turntable.csv"
CONFIG_ESPTOOLPY_FLASHSIZE_2MB=y
CONFIG_BOOTLOADER_APP_ROLLBACK_ENABLE=y
```

## 02_Software_Binbot/firmware/esp32c3/power-card/main/Kconfig.projbuild
```kconfig
menu "Power card"

    config POWER_CARD_WIFI_SSID
        string "Wi-Fi SSID (serial configuration overrides this)"
        default ""
        help
            Connects as a Wi-Fi station using DHCP. Leave empty and use the
            serial wifi command to save credentials in NVS on first setup.

    config POWER_CARD_WIFI_PASSWORD
        string "Wi-Fi password"
        default ""

    config POWER_CARD_TCP_PORT
        int "TCP command server port"
        range 1024 65535
        default 5000
        help
            IPv4 TCP server using newline-delimited JSON. Each request must
            carry the device token shown by the serial token command.

    config POWER_CARD_BUTTON_GPIO
        int "Power button output GPIO (-1 disables output)"
        range -1 21
        default 3
        help
            IO-1 on the schematic: GPIO3 drives Q1 and the PW PhotoMOS.
            Set -1 to disable this output.
            GPIO12-17 are reserved for flash. Console pins are also rejected.

    config POWER_CARD_BUTTON_ACTIVE_HIGH
        bool "Power button output is active high"
        default y
        help
            Enable for a switch circuit activated by a high GPIO level.
            Otherwise a low level activates the switch.

    config POWER_CARD_BUTTON_PRESS_MS
        int "Short press duration (milliseconds)"
        range 100 1000
        default 500

    config POWER_CARD_RESET_GPIO
        int "Reset button output GPIO (-1 disables output)"
        range -1 21
        default 4
        help
            IO-2 on the schematic: GPIO4 drives Q2 and the RST PhotoMOS.

    config POWER_CARD_RESET_ACTIVE_HIGH
        bool "Reset button output is active high"
        default y

    config POWER_CARD_RESET_PRESS_MS
        int "Reset press duration (milliseconds)"
        range 100 1000
        default 200

    config POWER_CARD_LOCAL_BUTTON_GPIO
        int "Local power button input GPIO (-1 disables input)"
        range -1 21
        default 5
        help
            IO-SW on the schematic: GPIO5 is connected to SW2 and ground.
            Uses an internal pull-up and 50 ms debounce. A held button on
            boot must be released before it can trigger a press.

    config POWER_CARD_LED_SENSE_GPIO
        int "Power LED sense input GPIO (-1 disables input)"
        range -1 21
        default 10
        help
            GPIO10 samples the PW_LED+ circuit using its external pull-down.
            Reports raw level only; PC power-state interpretation is deferred
            until the D4 clamp direction and actual waveforms are confirmed.

endmenu
```

## 02_Software_Binbot/firmware/esp32c3/power-card/sdkconfig.defaults
```kconfig
CONFIG_IDF_TARGET="esp32c3"
CONFIG_ESPTOOLPY_FLASHSIZE_4MB=y
CONFIG_PARTITION_TABLE_TWO_OTA_LARGE=y
CONFIG_BOOTLOADER_APP_ROLLBACK_ENABLE=y
# CONFIG_ESP_HTTP_CLIENT_ENABLE_HTTPS is not set
CONFIG_ESP_CONSOLE_UART_DEFAULT=y
CONFIG_ESP_CONSOLE_SECONDARY_NONE=y
CONFIG_POWER_CARD_BUTTON_GPIO=3
CONFIG_POWER_CARD_BUTTON_PRESS_MS=500
CONFIG_POWER_CARD_BUTTON_ACTIVE_HIGH=y
CONFIG_POWER_CARD_RESET_GPIO=4
CONFIG_POWER_CARD_RESET_ACTIVE_HIGH=y
CONFIG_POWER_CARD_RESET_PRESS_MS=200
CONFIG_POWER_CARD_LOCAL_BUTTON_GPIO=5
CONFIG_POWER_CARD_LED_SENSE_GPIO=10
CONFIG_POWER_CARD_TCP_PORT=5000
```
